## min-turnup/phase2/Kconfig
```kconfig
menu "Phase 2: Node Bootstrapping"

config phase2.docker_registry
	string "docker registry"
	default "docker.io/colemickens"
	help
	  The docker registry to pull cluster components from.

config phase2.kubernetes_version
	string "kubernetes version"
	default "v1.3.0-azure"
	help
	  The version of Kubernetes to deploy.

config phase2.installer_container_spec
	string "installer container"
	default "docker.io/colemickens/install-k8s:v1"

endmenu
```

## min-turnup/phase3/Kconfig
```kconfig
menu "Phase 3: Deploying Addons"

config phase3.run_addons
	bool "Run the addon manager?"
	default y
	help
	  Should we deploy the addon manager?

if phase3.run_addons

config phase3.kube_proxy
	bool "Run kube-proxy?"
	default y
	help
	  Should we deploy the kube-proxy to nodes?

config phase3.dashboard
	bool "Run the dashboard?"
	default y
	help
	  Should we deploy the kubernetes dashboard?

endif

endmenu
```
